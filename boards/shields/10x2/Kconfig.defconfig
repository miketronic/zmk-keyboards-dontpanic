## boards/shields/10x2/Kconfig.defconfig
```kconfig
# Copyright (c) 2024 The ZMK Contributors
# SPDX-License-Identifier: MIT

if SHIELD_10x2

config ZMK_KEYBOARD_NAME
    default "10x2"

endif
```

## boards/shields/10x2/Kconfig.shield
```kconfig
# Copyright (c) 2024 The ZMK Contributors
# SPDX-License-Identifier: MIT

config SHIELD_10x2
    def_bool $(shields_list_contains,10x2)
```

## boards/shields/dontpanic/Kconfig.defconfig
```kconfig
# Copyright (c) 2024 The ZMK Contributors
# SPDX-License-Identifier: MIT

if SHIELD_dontpanic

config ZMK_KEYBOARD_NAME
    default "dontpanic"

endif
```
